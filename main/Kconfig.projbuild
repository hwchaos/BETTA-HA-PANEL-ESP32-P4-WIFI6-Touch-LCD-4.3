## main/Kconfig.projbuild
```kconfig
# SPDX-License-Identifier: LicenseRef-FNCL-1.1
# Copyright (c) 2026 Cpt_Kirk
menu "Example Configuration"

menu "Panel Hardware"

choice APP_PANEL_BOARD
    prompt "Board"
    default APP_PANEL_BOARD_WAVESHARE_43
    help
        The board this firmware image is built for. sdkconfig.defaults.panel43
        and sdkconfig.defaults.p4eth101 select it.

config APP_PANEL_BOARD_WAVESHARE_43
    bool "Waveshare ESP32-P4-WIFI6-Touch-LCD-4.3 (480x800, ST7701, Wi-Fi via C6)"

config APP_PANEL_BOARD_WAVESHARE_P4ETH101
    bool "Waveshare ESP32-P4-POE-ETH-KIT-B (10.1\" 800x1280, Ethernet)"
    help
        10.1" 800x1280 DSI panel (Nano BSP), ES8311 audio and IP101 Ethernet
        instead of Wi-Fi.

endchoice

endmenu

menu "Local Camera (MIPI-CSI)"

config APP_FEATURE_LOCAL_CAMERA
    bool "OV5647 MIPI-CSI camera support"
    default n
    help
        Support for an OV5647 camera on the board's MIPI-CSI connector:
        on-panel preview, snapshot endpoint (/api/camera/snapshot), MJPEG
        stream (/api/camera/stream), camera status endpoint and motion-based
        screen wake.

        Carried over from the Waveshare 7B port and not yet tested on the
        4.3" board or the ETH kit (CSI/SCCB wiring may need adjusting).
        The sensor format is selected through the esp_cam_sensor (OV5647)
        Kconfig, not here.

config APP_LOCAL_CAMERA_HFLIP
    bool "Horizontally mirror camera image"
    default y
    depends on APP_FEATURE_LOCAL_CAMERA
    help
        Apply a horizontal flip to the captured image.  Default enabled to
        match the Waveshare demo orientation.

config APP_LOCAL_CAMERA_VFLIP
    bool "Vertically mirror camera image"
    default n
    depends on APP_FEATURE_LOCAL_CAMERA
    help
        Apply a vertical flip to the captured image.

config APP_LOCAL_CAMERA_MOTION_WAKE
    bool "Wake screen on camera motion"
    default y
    depends on APP_FEATURE_LOCAL_CAMERA
    help
        Use a lightweight frame-difference detector on the camera stream to
        wake the screen when someone approaches the panel while the display
        is dimmed or off.

config APP_LOCAL_CAMERA_JPEG_QUALITY
    int "Snapshot JPEG quality (1-100)"
    range 10 95
    default 55
    depends on APP_FEATURE_LOCAL_CAMERA
    help
        JPEG quality used for /api/camera/snapshot.  Higher values produce
        larger images.

endmenu

menu "Wi-Fi Station"

config APP_WIFI_SSID
    string "Wi-Fi SSID"
    default "YOUR_WIFI_SSID"
    help
        SSID of your access point.
        ESP32-C6 supports 2.4 GHz Wi-Fi.

config APP_WIFI_PASSWORD
    string "Wi-Fi Password"
    default "YOUR_WIFI_PASSWORD"
    help
        Password for your access point.
        Set empty only for open networks.

config APP_WIFI_COUNTRY_CODE
    string "Wi-Fi country code (ISO-3166 alpha-2)"
    default "US"
    help
        Two-letter country code used for Wi-Fi regulatory domain
        (for example US, DE, FR). This is used as default and can
        be overridden at runtime in provisioning/settings.

config APP_WIFI_WAIT_FOR_IP
    bool "Wait for IP before continuing boot"
    default y
    help
        If enabled, startup waits until station got IP or timeout.

config APP_WIFI_CONNECT_TIMEOUT_MS
    int "Wi-Fi connect timeout (ms)"
    range 1000 120000
    default 15000
    help
        Maximum time to wait for IP when wait-for-IP is enabled.

config APP_WIFI_MAX_RETRIES
    int "Wi-Fi max reconnect retries"
    range 1 100
    default 8
    help
        Number of reconnect attempts after disconnect.

config APP_WIFI_DISABLE_POWER_SAVE
    bool "Disable Wi-Fi power save (WIFI_PS_NONE)"
    default y
    help
        Forces Wi-Fi modem power-save off on the hosted C6 via esp_wifi_set_ps(WIFI_PS_NONE).
        Recommended for maximum websocket stability.

endmenu

menu "ESP-Hosted"

config APP_HOSTED_AUTO_UPDATE_C6_FW
    bool "Auto-update C6 firmware on version mismatch"
    default y
    depends on ESP_HOSTED_ENABLED
    help
        If enabled, the host runs automatic C6 slave OTA using the bundled
        firmware image whenever running C6 firmware differs from host version,
        including 0.0.0/unknown coprocessor firmware recovery.

endmenu

menu "Home Assistant"

config APP_HA_WS_URL
    string "HA WebSocket URL"
    default "YOUR_HA_WS_URL"
    help
        Example: wss://homeassistant.local:8123/api/websocket

config APP_HA_ACCESS_TOKEN
    string "HA Long-lived Access Token"
    default "YOUR_HA_ACCESS_TOKEN"
    help
        Long-lived access token used for Home Assistant authentication.

config APP_HA_FETCH_INITIAL_STATES
    bool "Fetch initial states after auth_ok"
    default y
    help
        When enabled, the device sends Home Assistant get_states right after
        websocket authentication. This can be memory-intensive on constrained
        links; keep disabled for maximum runtime stability.

config APP_HA_SUBSCRIBE_STATE_CHANGED
    bool "Subscribe to HA state_changed event stream"
    default y
    help
        Enables global Home Assistant state_changed subscription.
        This can produce high event volume; keep disabled while focusing
        on transport stability, then enable once stable.

config APP_HA_PING_INTERVAL_MS
    int "HA ping interval (ms)"
    range 5000 120000
    default 8000
    help
        Periodic Home Assistant websocket "ping" message interval.
        Keeps the application session active even during long idle periods.

endmenu

menu "Time"

config APP_NTP_SERVER
    string "NTP server"
    default "pool.ntp.org"
    help
        NTP server used for time synchronization.

config APP_TIME_TZ
    string "Timezone (POSIX TZ)"
    default "CET-1CEST,M3.5.0/2,M10.5.0/3"
    help
        POSIX timezone string used for localtime conversion.
        Default is Europe/Berlin with automatic DST switching.

endmenu

endmenu
```
